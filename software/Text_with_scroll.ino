/*
  RPi-WS2812-HAT Text with Scroll Example
  
  Based on original Text.ino example
  Modified by: Manel Vilar
 */

#include <WS2812.h>
//#include <avr/pgmspace.h>

#define DATAPIN     1 //digital output pin (data input of LEDs)
#define LEDCOUNT   64 //number of LEDs to drive
#define INTENSITY 100 //light intensity

WS2812 LED(LEDCOUNT);

byte intensity=2;
byte sign=0;

const byte font_data[] PROGMEM =
{
  0x00,0x00,0x00,0x00,0x00,0x00,0x00,0x00, // 0x20
  0x30,0x78,0x78,0x30,0x30,0x00,0x30,0x00, // 0x21
  0x6C,0x6C,0x6C,0x00,0x00,0x00,0x00,0x00, // 0x22
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  0x10,0x38,0x6C,0xC6,0xC6,0xC6,0xFE,0x00  // 0x7F
};

void setup()
{
  //init LEDs
  LED.setOutput(DATAPIN);
  //LED.setColorOrderRGB(); //uncomment for RGB color order
  //LED.setColorOrderBRG(); //uncomment for BRG color order
  LED.setColorOrderGRB(); //ucomment for GRB color order (default)
}

void write_ch(char c, char t, cRGB fg, cRGB bg, int offset, byte start_x)
{
  uint_least16_t pos, pos2;
  uint_least8_t data, data2, data3, mask;
  uint_least8_t i, j, width, height;
  const uint_least8_t *ptr PROGMEM;
  const uint_least8_t *ptr2 PROGMEM;
  const uint_least8_t *tptr PROGMEM;

  if((c < 0x20) || (c > 0x7F))
  {
    return;
  }

  pos = (c-0x20)*(8*8/8); //8x8 font
  ptr = &font_data[pos];

  pos2 = (t-0x20)*(8*8/8); //8x8 font
  ptr2 = &font_data[pos2];

  byte x, x2;
  for(byte y=0; y < 8; y++)
  {
    data = pgm_read_byte(ptr++);
    data >>=1; //offset 1 pixel to left

    x = start_x;
    for(mask=(1<<(offset-1)); mask!=0; mask>>=1, x++)
    {      
      if(data & mask)
      {
        LED.set_crgb_at((x*8)+y, fg); //set character on pixel
      }
      else
      {
        LED.set_crgb_at((x*8)+y, bg); //set character off pixel
      }
    }

    data2 = pgm_read_byte(ptr2++);
    data2 >>=1; //offset 1 pixel to left
 
    x2 = offset;
    for(mask=(1<<(8-1)); x2<9; mask>>=1, x2++)
    {      
      if(data2 & mask)
      {
        LED.set_crgb_at((x2*8)+y, fg); //set character on pixel
      }
      else
      {
        LED.set_crgb_at((x2*8)+y, bg); //set character off pixel
      }
    }
  }
}

void write_s(char *s, cRGB fg, cRGB bg, int ms)
{
  int offset;
  char *t;

  t = s;
  *t++;

  while(*s)
  {
    delay(50);
    for (offset = 8; offset > 0; offset--)
    {
      if (*t)
      {
        write_ch(*s, *t, fg, bg, offset, 0);
      }
      LED.sync(); //send the values to the LEDs

      delay(ms); //wait
    }
    *s++;
    *t++;
  }
  write_ch(' ', ' ', fg, bg, 0, 0); //clear after last letter
}

void loop()
{
  cRGB fg, bg;

  //customize the color for each run here
  fg.r = random(0, 100);
  fg.g = random(0, 100);
  fg.b = random(0, 100);

  bg.r = 0;
  bg.g = 0;
  bg.b = 0;

  //last parameter is delay in ms for each letter
  write_s("Hello, World!", fg, bg, 150);
  delay(1000);
}
