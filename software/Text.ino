/*
  RPi-WS2812-HAT Text Example
 */

#include <WS2812.h>
//#include <avr/pgmspace.h>

#define DATAPIN     1 //digital output pin (data input of LEDs)
#define LEDCOUNT   64 //number of LEDs to drive
#define INTENSITY 100 //light intensity

WS2812 LED(LEDCOUNT);

byte intensity=0;
byte sign=1;

const byte font_data[] PROGMEM =
{
  0x00,0x00,0x00,0x00,0x00,0x00,0x00,0x00, // 0x20
  0x30,0x78,0x78,0x30,0x30,0x00,0x30,0x00, // 0x21
  0x6C,0x6C,0x6C,0x00,0x00,0x00,0x00,0x00, // 0x22
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  0x10,0x38,0x6C,0xC6,0xC6,0xC6,0xFE,0x00  // 0x7F
};

void setup()
{
  //init LEDs
  LED.setOutput(DATAPIN);
  //LED.setColorOrderRGB(); //uncomment for RGB color order
  //LED.setColorOrderBRG(); //uncomment for BRG color order
  LED.setColorOrderGRB(); //ucomment for GRB color order (default)
}

void write_ch(char c, cRGB fg, cRGB bg)
{
  uint_least16_t pos;
  uint_least8_t data, mask;
  uint_least8_t i, j, width, height;
  const uint_least8_t *ptr PROGMEM;

  if((c < 0x20) || (c > 0x7F))
  {
    return;
  }

  pos = (c-0x20)*(8*8/8); //8x8 font
  ptr = &font_data[pos];

  for(byte y=0; y < 8; y++)
  {
    data = pgm_read_byte(ptr++);
    data >>=1; //offset 1 pixel to left
    for(byte x=0, mask=(1<<(8-1)); mask!=0; mask>>=1, x++)
    {
      if(data & mask)
      {
        LED.set_crgb_at((x*8)+y, fg); //set character on pixel
      }
      else
      {
        LED.set_crgb_at((x*8)+y, bg); //set character off pixel
      }
    }
  }
  LED.sync(); //send the values to the LEDs
}

void write_s(char *s, cRGB fg, cRGB bg, int ms)
{
  while(*s)
  {
    write_ch(' ', fg, bg); //clear before letter
    delay(50);
    write_ch(*s++, fg, bg);
    delay(ms); //wait
  }
  write_ch(' ', fg, bg); //clear after last letter
}

void loop()
{
  cRGB fg, bg;

  if(sign)
  {
    intensity+=5;
    if(intensity >= INTENSITY)
    {
      sign = 0;
    }
  }
  else
  {
    intensity-=5;
    if(intensity <= 10)
    {
      sign = 1;
    }
  }

  fg.r = intensity;
  fg.g = 0;
  fg.b = 0;

  bg.r = 0;
  bg.g = 0;
  bg.b = 0;

  write_s("Hello World!", fg, bg, 500);
  delay(1000);
}
